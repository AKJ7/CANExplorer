AUTOSAR XML (schema 00046)
standard types defined: uint8, uint16
package /Datatypes
  base type uint8_t: base-type-size=8, base-type-encoding=NONE
  base type uint16_t: base-type-size=16, base-type-encoding=NONE
  base type float32_t: base-type-size=32, base-type-encoding=IEEE754
  impl type Position: category=STRUCTURE
    element x: category=VALUE, base-type=float32_t
    element y: category=VALUE, base-type=float32_t
  impl type Reading: category=UNION
    element as_byte: type=uint8
    element as_word: type=uint16
package /Services
  service interface RadarService
    methods:
      operation Configure
        arg mode: type=uint8, direction=IN
        arg status: type=uint16, direction=OUT
    events:
      data Target: type=Position
      data Level: type=Reading
package /Deployment
  someip service interface deployment RadarServiceDeployment: service-interface=RadarService, service-interface-id=4660
    someip method deployment ConfigureDeployment: method=Configure, method-id=1
    someip event deployment TargetDeployment: event=Target, event-id=32769
    someip event deployment LevelDeployment: event=Level, event-id=32770
