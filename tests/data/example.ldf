LIN_description_file;
LIN_protocol_version = "2.1";
LIN_language_version = "2.1";
LIN_speed = 19.2 kbps;

Nodes {
  Master: BCM, 5 ms, 0.1 ms;
  Slaves: SeatECU, LightECU;
}

Signals {
  SeatPosition: 8, 0, SeatECU, BCM;
  SeatTemperature: 16, 0, SeatECU, BCM;
  SeatHeating: 2, 0, BCM, SeatECU;
  LightLevel: 7, 0, LightECU, BCM;
  LightOn: 1, 0, BCM, LightECU;
}

Frames {
  SeatStatus: 0x10, SeatECU, 3 {
    SeatPosition, 0;
    SeatTemperature, 8;
  }
  SeatControl: 0x11, BCM, 1 {
    SeatHeating, 0;
  }
  LightStatus: 0x20, LightECU, 1 {
    LightLevel, 0;
  }
  LightControl: 0x21, BCM, 1 {
    LightOn, 0;
  }
}

Node_attributes {
  SeatECU {
    LIN_protocol = "2.1";
    configured_NAD = 0x01;
    initial_NAD = 0x01;
    product_id = 0x1234, 0x5678, 0;
    P2_min = 50 ms;
    ST_min = 0 ms;
    configurable_frames {
      SeatStatus;
      SeatControl;
    }
  }
  LightECU {
    LIN_protocol = "2.1";
    configured_NAD = 0x02;
    initial_NAD = 0x02;
    product_id = 0x1234, 0x9ABC, 0;
    P2_min = 50 ms;
    ST_min = 0 ms;
    configurable_frames {
      LightStatus;
      LightControl;
    }
  }
}

Schedule_tables {
  NormalTable {
    SeatStatus delay 10 ms;
    SeatControl delay 10 ms;
    LightStatus delay 10 ms;
    LightControl delay 10 ms;
  }
  DiagnosticTable {
    MasterReq delay 10 ms;
    SlaveResp delay 10 ms;
  }
}

Signal_encoding_types {
  PositionEncoding {
    physical_value, 0, 200, 0.5, 0, "mm";
  }
  TemperatureEncoding {
    physical_value, 0, 65534, 0.1, -40, "degC";
  }
  HeatingEncoding {
    logical_value, 0, "Off";
    logical_value, 1, "Low";
    logical_value, 2, "High";
  }
}

Signal_representation {
  PositionEncoding: SeatPosition;
  TemperatureEncoding: SeatTemperature;
  HeatingEncoding: SeatHeating;
}
